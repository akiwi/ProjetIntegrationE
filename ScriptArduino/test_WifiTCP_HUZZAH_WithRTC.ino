#include <ESP8266WiFi.h>
#include <Adafruit_GFX.h>
#include <Adafruit_SSD1306.h>
#include "RTClib.h"

Adafruit_SSD1306 display = Adafruit_SSD1306();
RTC_DS3231 rtc;
char daysOfTheWeek[7][12] = {"Sunday", "Monday", "Tuesday", "Wednesday", "Thursday", "Friday", "Saturday"}; // sera utilise lorsqu on implementera les dates pour les alarmes
const char* ssid     = "";			  //SSID
const char* password = "";    		  //PSWD
const int port = 5005;                //PORT
const char* host = "109.133.170.117"; //IP HOST

//constante qui contient l image du verre
const unsigned char PROGMEM verre2 [] = {
0x00, 0x00, 0x00, 0x00, 0x00, 0x00, 0x00, 0x00, 0x00, 0x00, 0x00, 0x00, 0x00, 0x00, 0x00, 0x00,
0x00, 0x00, 0x00, 0x00, 0x00, 0x00, 0x00, 0x00, 0x00, 0x00, 0x00, 0x00, 0x00, 0x00, 0x00, 0x00,
0x00, 0x00, 0x00, 0x00, 0x00, 0x00, 0x00, 0x00, 0x00, 0x3F, 0x80, 0x00, 0x00, 0x00, 0x00, 0x00,
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0x00, 0x00, 0x00, 0x00, 0x00, 0x00, 0x00, 0x00, 0x00, 0x00, 0x00, 0x00, 0x00, 0x00, 0x00, 0x00
};

void setup() {
  Serial.begin(115200);
  delay(10);

  // initialisation du oled 128x32
  display.begin(SSD1306_SWITCHCAPVCC, 0x3C);  
  delay(1000);
  display.clearDisplay();
  display.display();
  display.setTextSize(1);
  display.setTextColor(WHITE);
  display.setCursor(0,0);

  //Verifie que le RTC est bien connecte
  if (! rtc.begin()) {
    Serial.println("Couldn't find RTC");
    while (1);
  }
  
  //initialise l heure au cas ou cela n a pas ete fait
  if (rtc.lostPower()) {
    Serial.println("RTC lost power, lets set the time!");
    // following line sets the RTC to the date & time this sketch was compiled
    rtc.adjust(DateTime(F(__DATE__), F(__TIME__)));
    // This line sets the RTC with an explicit date & time, for example to set
    // January 21, 2014 at 3am you would call:
    // rtc.adjust(DateTime(2014, 1, 21, 3, 0, 0));
  }

  //Connection au WiFi et affichage sur l ecran
  Serial.println();
  display.print("Connecting to ");
  Serial.print("Connecting to ");
  Serial.println(ssid);
  display.println(ssid);
  display.display();
  WiFi.begin(ssid, password);
  //Tant que le WiFi n est pas connecte on affiche des points
  while (WiFi.status() != WL_CONNECTED) {
    delay(500);
    Serial.print(".");
  }

  //affichage de la reussite de connection 
  Serial.println("");
  Serial.println("WiFi connected");
  display.println("WiFi connected");
  Serial.println("IP address: ");
  display.println(WiFi.localIP());
  Serial.println(WiFi.localIP());
  display.display();  
}

//variables pour l affichage de l heure
//on sotcke l heure afin de ne rafraichir l ecran que quand l heure a changee
int value = 0;
int hour = 0;
int minute = 0;

void loop() {
  DateTime now = rtc.now();
  delay(1000);
  ++value;
  Serial.print("connecting to ");
  Serial.println(host);

  //on rafraichi l ecran si l heure a changee (+1 min)
  if(hour!=now.hour()||minute!=now.minute()){
    display.clearDisplay();
    display.setTextSize(3);
    display.setTextColor(WHITE);
    display.setCursor(20,6);
    display.print(now.hour(), DEC);
    display.print(':');
    display.print(now.minute(), DEC);
    display.display();  
    hour=now.hour();
    minute=now.minute();
  }
  
  // Creation de la connection TCP
  WiFiClient client;
  if (!client.connect(host, port)) {
    Serial.println("connection failed");
    return;
  }

  // Envoi d une requete au serveur
  client.print("repas");
  delay(10);

  
  Serial.println("Respond:");
  //Tant qu il y a connection
  while(client.available()){
    String line = client.readStringUntil('\r');
    display.clearDisplay();
    display.display();
    display.setCursor(0,0);
    Serial.print(line);
    display.println(line);
    delay(1000);
    //si on recoit le message eau alors on affiche un verre d eau
    if(line.equals("eau")){  
      display.clearDisplay();
      display.setCursor(0,0);
      display.drawBitmap( 0, 0, verre2, 124, 31, 1);
      display.display();
      delay(5000);
      display.clearDisplay();
      display.display();
    }
  }

  Serial.println();
  Serial.println("closing connection");
}
